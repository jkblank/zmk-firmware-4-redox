## boards/shields/redox_handwire/Kconfig.defconfig
```kconfig
if SHIELD_REDOX_HANDWIRE_LEFT

config ZMK_KEYBOARD_NAME
    default "Redox"

config ZMK_SPLIT_ROLE_CENTRAL
    default y

endif

if SHIELD_REDOX_HANDWIRE_LEFT || SHIELD_REDOX_HANDWIRE_RIGHT

config ZMK_SPLIT
    default y

endif
```

## boards/shields/redox_handwire/Kconfig.shield
```kconfig
config SHIELD_REDOX_HANDWIRE_LEFT
    def_bool $(shields_list_contains,redox_handwire_left)

config SHIELD_REDOX_HANDWIRE_RIGHT
    def_bool $(shields_list_contains,redox_handwire_right)
```
